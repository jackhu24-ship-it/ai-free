ASAP2_VERSION 1 71
/begin PROJECT AutoCopilot_Industrial_ECU "AutoCopilot ASIL-D Calibration Description"
/begin HEADER "AutoCopilot SOP 2028 Calibration" VERSION "4.0.0" /end HEADER
/begin MODULE AutoCopilot_Core ""
/begin CHARACTERISTIC FTTI_Target_Limit "Maximum Fault Tolerant Time Interval" VALUE 0x001000 ULONG 0.0 40.0 FORMAT "%4.1f" UNIT "ms" /end CHARACTERISTIC
/begin CHARACTERISTIC CRC_Fault_Threshold "Continuous CRC-8 Error Threshold" VALUE 0x001004 UBYTE 1.0 3.0 FORMAT "%1.0f" UNIT "frames" /end CHARACTERISTIC
/begin CHARACTERISTIC Max_Safe_Torque "Upper Bound Safe Torque" VALUE 0x001008 FLOAT 0.0 700.0 FORMAT "%5.1f" UNIT "Nm" /end CHARACTERISTIC
/end MODULE
/end PROJECT
